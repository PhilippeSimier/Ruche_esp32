/* 
 * File:   FeldHell.cpp
 * Author: philippe
 * 
 * Created on 3 août 2021, 09:35
 */

#include "FeldHell.h"

/**
 * @brief Constructeur avec paramètres 
 * @param Freq   Fréquency 
 * @param br     Baud rate () 
 */
FeldHell::FeldHell(float _frequency, float _br) :
leFsk(new Fsk(_frequency, 0, _br * 2)),
frequency(_frequency),
br(_br) {
    leFsk->begin();
}

FeldHell::FeldHell(const FeldHell& orig) {
}

FeldHell::~FeldHell() {
    delete leFsk;
}

void FeldHell::tx(char * message) {
    leFsk->start();

    const static word GlyphTab[59][8] PROGMEM = {
        {0x0000, 0x0000, 0x0000, 0x0000, 0x0000, 0x0000, 0x0000},
        {0x1f9c, 0x0000, 0x0000, 0x0000, 0x0000, 0x0000, 0x0000},
        {0x0000, 0x0000, 0x0000, 0x0000, 0x0000, 0x0000, 0x0000},
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        {0x0c1c, 0x0c7c, 0x0ccc, 0x0f8c, 0x0e0c, 0x0000, 0x0000}
    };
    int val;
    char ch;
    int n;
    word fbits;
    ch = *message++;
    while (ch != '\0') {
        ch = toupper(int(ch));          // Uppercase
        if (ch >= 32 && ch <= 90)       // Character is in the range of ASCII space to Z
        {
            ch -= 32;                   // Character number starting at 0
            for (int i = 0; i < 7; i++) // Scanning each 7 columns of glyph
            {
                fbits = int(pgm_read_word(&GlyphTab[int(ch)][i])); // Get each column of glyph
                for (int b = 0; b < 14; b++) // Scanning each 14 rows
                {
                    val = bitRead(fbits, b); // Get binary state of pixel          
                    if (val == 1) {
                        leFsk->sendBit(1);   // dds.sendBitFreq(frequency);
                    } else {
                        leFsk->sendBitOff(); 
                    }
                }
            }
        }
        ch = *message++; // Next character in string
    }
    leFsk->stop();

}

